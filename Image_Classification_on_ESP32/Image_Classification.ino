#include <EloquentTinyML.h>
// This file has the TFlite model generated by the Cars_Classify_Tflite_hex.ipynb 
// In the directory: G:\Users\Mouli\IIITL\AI-for-IoT\PresentationMaterials\SampleProgs\Keras\classify\cars
// Done on 7 Apr 2021
// sine_model.h contains the array you exported from the previous step with xxd or tinymlgen
#include "cactus_seq_model_esp32.h"
#include "cactus_X_test0_data.h"
#include "cactus_X_test2_data.h"

#define NUMBER_OF_INPUTS 32*32*3 
#define NUMBER_OF_OUTPUTS 2

// in future projects you may need to tweek this value: it's a trial and error process
//#define TENSOR_ARENA_SIZE 3*1024  // Since the size is 2960 here, this needs to be changed from 2*1024 to 3*1024

#define TENSOR_ARENA_SIZE 88*1024  // Since the size is 828844 (219) old value: 828680 (810)for cactus model

Eloquent::TinyML::TfLite<NUMBER_OF_INPUTS, NUMBER_OF_OUTPUTS, TENSOR_ARENA_SIZE> ml;

void setup() {
    Serial.begin(115200);
    
    Serial.println("Actual Predicted"); // To print the labels of the values being plotted.
    Serial.print(-1);
    Serial.print("\t");
    Serial.println(+1);
        
    ml.begin(cactus_seq_model_esp32);
}

static float fResult[NUMBER_OF_OUTPUTS] = {100.100, 200.200};
static float fRes = 99.99f;

void loop() {

    Serial.print("\nThe Input values passed through x_test2[] is:\n");    
    displayInput(x_test2);

    delay(2);
    
    initfResult(fResult);
    fRes = ml.predict((float*) x_test2, fResult);
    Serial.print("The output value returned for x_test2 is:\n");

    displayOutput(fResult);
    
    Serial.print("\nThe Input values passed through x_test0[] is:\n");    
    displayInput(x_test0);
    
    initfResult(fResult);
    fRes = ml.predict((float*)x_test0, fResult);
    Serial.print("The output value returned for x_test0 is:\n");

    displayOutput(fResult);

    delay(3000); // 3 seconds of delay between two plots
}

void initfResult(float *fResult){
  
    for(int i = 0; i < NUMBER_OF_OUTPUTS; i++){
       fResult[i] = 0.0f;
    }
} // end of displayOutput()

void displayOutput(float *fResult){
  
    for(int i = 0; i < NUMBER_OF_OUTPUTS; i++){
        Serial.print(fResult[i]);
        Serial.print(" ");
    }
    Serial.println("");
    
} // end of displayOutput()

void displayInput(const float *fInput){
  
    for(int i = 0; i < NUMBER_OF_INPUTS; i++){
        Serial.print(fInput[i]);
        Serial.print(" ");
    }
    Serial.println("");
} // end of displayInput()
